#include <dt-bindings/zmk/matrix_transform.h>

/ {
    chosen {
        zmk,kscan = &kscan0;
    };

    kscan0: kscan {
        compatible = "zmk,kscan-gpio-matrix";
        label = "KSCAN";
        diode-direction = "col2row";

        row-gpios
            = <&gpio0 20 (GPIO_ACTIVE_HIGH | GPIO_PULL_DOWN)> // Row 0
            , <&gpio0 19 (GPIO_ACTIVE_HIGH | GPIO_PULL_DOWN)> // Row 1
            , <&gpio0 18 (GPIO_ACTIVE_HIGH | GPIO_PULL_DOWN)> // Row 2
            , <&gpio0 17 (GPIO_ACTIVE_HIGH | GPIO_PULL_DOWN)> // Row 3
            , <&gpio0 16 (GPIO_ACTIVE_HIGH | GPIO_PULL_DOWN)> // Row 4
            , <&gpio0 15 (GPIO_ACTIVE_HIGH | GPIO_PULL_DOWN)> ; // Row 5

        col-gpios
            = <&gpio0 14 GPIO_ACTIVE_HIGH> // Col 0
            , <&gpio0 13 GPIO_ACTIVE_HIGH> // Col 1
            , <&gpio1 7  GPIO_ACTIVE_HIGH> // Col 2 (P1.07)
            , <&gpio1 2  GPIO_ACTIVE_HIGH> // Col 3 (P1.02)
            , <&gpio1 1  GPIO_ACTIVE_HIGH> // Col 4 (P1.01)
            , <&gpio0 12 GPIO_ACTIVE_HIGH> // Col 5
            , <&gpio0 11 GPIO_ACTIVE_HIGH> // Col 6
            , <&gpio0 9  GPIO_ACTIVE_HIGH> ; // Col 7
    };
};